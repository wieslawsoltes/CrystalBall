## firmware/main/Kconfig.projbuild
```kconfig
menu "Aether Orb"
config ORB_FACTORY_DIAGNOSTICS
    bool "Offline factory diagnostics (NOT customer firmware)"
    default n
    help
        Button-driven optical patterns, low-brightness pixel walk, hold-to-play
        test tone and digital microphone statistics. No Wi-Fi, gateway CA or
        credential loading. Remove DevKit from BOTH sockets before flashing.

config ORB_MIRROR_X
    bool "Mirror display horizontally (adjust using optical calibration)"
    default y
config ORB_MIRROR_Y
    bool "Mirror display vertically"
    default n
config ORB_MIC_SHIFT
    int "I2S signed 32-bit sample right shift before int16 conversion"
    range 8 20
    default 14
    help
        Confirm SPH0645 timing/alignment on the actual microphone with a scope
        and a 1 kHz tone. This setting is gain/alignment, not a replacement for
        correct I2S timing. Do not release hardware until the audio gate passes.
config ORB_RECORD_SECONDS
    int "Maximum push-to-talk capture seconds"
    range 1 8
    default 8
config ORB_CALIBRATION_BOOT
    bool "Display calibration grid instead of connecting to gateway"
    depends on !ORB_FACTORY_DIAGNOSTICS
    default n
config ORB_PUBLIC_TTS
    bool "Public synthesized speech (privacy lost, explicit disclosure required)"
    depends on !ORB_FACTORY_DIAGNOSTICS
    default n
config ORB_AUTO_ERASE_SECONDS
    int "Erase response after seconds"
    range 15 300
    default 120
endmenu
```

## firmware/sdkconfig.defaults
```kconfig
CONFIG_IDF_TARGET="esp32s3"
CONFIG_ESPTOOLPY_FLASHMODE_QIO=y
CONFIG_ESPTOOLPY_FLASHSIZE_8MB=y
CONFIG_SPIRAM=y
CONFIG_SPIRAM_MODE_OCT=y
CONFIG_SPIRAM_SPEED_80M=y
CONFIG_SPIRAM_USE_MALLOC=y
CONFIG_PARTITION_TABLE_CUSTOM=y
CONFIG_PARTITION_TABLE_CUSTOM_FILENAME="partitions.csv"
CONFIG_ESP_MAIN_TASK_STACK_SIZE=16384
CONFIG_COMPILER_OPTIMIZATION_PERF=y
CONFIG_ESP_WIFI_NVS_ENABLED=y
CONFIG_MBEDTLS_CERTIFICATE_BUNDLE=n
CONFIG_MBEDTLS_DYNAMIC_BUFFER=y
CONFIG_ESP_CONSOLE_USB_SERIAL_JTAG=y
CONFIG_LOG_DEFAULT_LEVEL_WARN=y
CONFIG_ESP_TLS_SKIP_SERVER_CERT_VERIFY=n
```
